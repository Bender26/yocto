## build/conf/bblayers.conf
```bitbake
# POKY_BBLAYERS_CONF_VERSION is increased each time build/conf/bblayers.conf
# changes incompatibly
POKY_BBLAYERS_CONF_VERSION = "2"

BBPATH = "${TOPDIR}"
BBFILES ?= ""

BBLAYERS ?= " \
  /home/bender/yocto/poky/meta \
  /home/bender/yocto/poky/meta-poky \
  /home/bender/yocto/meta-openembedded/meta-oe \
  /home/bender/yocto/meta-openembedded/meta-python \
  /home/bender/yocto/meta-st-stm32mp \
  /home/bender/yocto/meta-mp1distro \
  "
```

## meta-mp1distro/conf/layer.conf
```bitbake
# We have a conf and classes directory, add to BBPATH
BBPATH .= ":${LAYERDIR}"

# We have recipes-* directories, add to BBFILES
BBFILES += "${LAYERDIR}/recipes-*/*/*.bb \
                      ${LAYERDIR}/recipes-*/*/*.bbappend"

BBFILE_COLLECTIONS += "meta-mp1distro"
BBFILE_PATTERN_meta-mp1distro = "^${LAYERDIR}/"
BBFILE_PRIORITY_meta-mp1distro = "6"

LAYERDEPENDS_meta-mp1distro = "core"
LAYERSERIES_COMPAT_meta-mp1distro = "dunfell"
```
